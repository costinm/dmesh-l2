## esp32/main/Kconfig.projbuild
```kconfig
menu "DMesh Configuration"

    config DUMP_BT
        bool "Dump BT HCI"
        default y
        help
            If a patched bt_trace.h is used, will show all BT HCI messages.

endmenu
```

## esp32/sdkconfig.defaults
```kconfig
# make defconfig - overrides for the default config

# Reduce bootloader log verbosity
CONFIG_BOOTLOADER_LOG_LEVEL_INFO=y
CONFIG_BOOTLOADER_LOG_LEVEL=3

CONFIG_ESPTOOLPY_BAUD_921600B=y

CONFIG_ESP32_DEFAULT_CPU_FREQ_80=y
CONFIG_ESP32_DEFAULT_CPU_FREQ_MHZ=80
CONFIG_ESP32_XTAL_FREQ_26=y
CONFIG_ESP32_XTAL_FREQ=26

CONFIG_PM_ENABLE=y
CONFIG_PM_DFS_INIT_AUTO=y
CONFIG_PM_USE_RTC_TIMER_REF=y

CONFIG_ESP32_WIFI_DEBUG_LOG_ENABLE=y
CONFIG_ESP32_WIFI_DEBUG_LOG_DEBUG=y
CONFIG_ESP32_WIFI_DEBUG_LOG_MODULE_WIFI=y
CONFIG_ESP32_WIFI_DEBUG_LOG_SUBMODULE=y
CONFIG_ESP32_WIFI_DEBUG_LOG_SUBMODULE_ALL=y
CONFIG_ESP32_WIFI_DEBUG_LOG_SUBMODULE=y
CONFIG_ESP32_WIFI_DEBUG_LOG_SUBMODULE_ALL=y

CONFIG_FREERTOS_USE_TICKLESS_IDLE=y
CONFIG_FREERTOS_IDLE_TIME_BEFORE_SLEEP=3

CONFIG_CS_GPIO=18
CONFIG_RST_GPIO=14
CONFIG_MISO_GPIO=19
CONFIG_MOSI_GPIO=27
CONFIG_SCK_GPIO=5
CONFIG_SCK_DIO0=26


# Increase main task stack size
CONFIG_ESP_MAIN_TASK_STACK_SIZE=7168

# Enable filesystem
CONFIG_PARTITION_TABLE_CUSTOM=y
CONFIG_PARTITION_TABLE_CUSTOM_FILENAME="partitions_example.csv"
CONFIG_PARTITION_TABLE_FILENAME="partitions_example.csv"

# Enable FreeRTOS stats formatting functions, needed for 'tasks' command
CONFIG_FREERTOS_USE_TRACE_FACILITY=y
CONFIG_FREERTOS_USE_STATS_FORMATTING_FUNCTIONS=y

CONFIG_ESPTOOLPY_FLASHSIZE_4MB=y
```
